/dts-v1/;
/plugin/;

/* Enable the 1368 MHz CPU OPP. The opp-microvolt value is declarative
 * only: the SmartPi One (NanoPi M1 design) has no software-controlled
 * CPU regulator, VDD-CPUX is fixed by the board hardware, so cpufreq
 * scales frequency only. 1368 MHz is stress-test validated on Yumi
 * boards at that fixed voltage. Applied as a user overlay
 * (/boot/overlay-user) by "smartpi-oc on".
 */

/ {
	compatible = "allwinner,sun8i-h3";

	fragment@0 {
		target-path = "/opp-table-cpu/opp-1368000000";
		__overlay__ {
			status = "okay";
			opp-microvolt = <1400000 1400000 1400000>;
		};
	};
};
